#include <physical_layouts.dtsi>

/ {
    TeeDa_physical_layout: TeeDa_physical_layout {
        compatible = "zmk,physical-layout";
        display-name = "TeeDa";
        transform = <&default_transform>;
        kscan = <&kscan0>;
        keys  //                     w   h    x    y     rot    rx    ry
            = <&key_physical_attrs 180 170 100 0 0 0 0>
             ,<&key_physical_attrs 180 170 200 0 0 0 0>
             ,<&key_physical_attrs 180 170 300 8 0 0 0>
             ,<&key_physical_attrs 180 170 400 13 0 0 0>
             ,<&key_physical_attrs 180 170 500 8 0 0 0>
             ,<&key_physical_attrs 180 170 600 8 0 0 0>
             ,<&key_physical_attrs 180 170 700 8 0 0 0>
             ,<&key_physical_attrs 180 170 800 8 0 0 0>
             ,<&key_physical_attrs 180 170 900 8 0 0 0>
             ,<&key_physical_attrs 180 170 1000 8 0 0 0>
             ,<&key_physical_attrs 180 170 1100 8 0 0 0>
             ,<&key_physical_attrs 180 170 1200 8 0 0 0>
             ,<&key_physical_attrs 180 170 1300 16 0 0 0>
             ,<&key_physical_attrs 180 170 1400 21 0 0 0>
             ,<&key_physical_attrs 180 170 1500 16 0 0 0>
             ,<&key_physical_attrs 180 170 1600 16 0 0 0>
             ,<&key_physical_attrs 180 170 1700 16 0 0 0>
             ,<&key_physical_attrs 180 170 1800 16 0 0 0>
             ,<&key_physical_attrs 180 170 1900 16 0 0 0>
             ,<&key_physical_attrs 180 170 2000 16 0 0 0>
             ,<&key_physical_attrs 180 170 2100 16 0 0 0>
             ,<&key_physical_attrs 180 170 2200 16 0 0 0>
             ,<&key_physical_attrs 180 170 0 (-169) 0 0 0>
             ,<&key_physical_attrs 180 170 100 (-169) 0 0 0>
             ,<&key_physical_attrs 180 170 200 (-161) 0 0 0>
             ,<&key_physical_attrs 180 170 300 (-156) 0 0 0>
             ,<&key_physical_attrs 180 170 400 (-161) 0 0 0>
             ,<&key_physical_attrs 180 170 500 (-161) 0 0 0>
             ,<&key_physical_attrs 180 170 600 (-161) 0 0 0>
             ,<&key_physical_attrs 180 170 700 (-161) 0 0 0>
             ,<&key_physical_attrs 180 170 800 (-161) 0 0 0>
             ,<&key_physical_attrs 180 170 900 (-161) 0 0 0>
             ,<&key_physical_attrs 180 170 1000 (-161) 0 0 0>
             ,<&key_physical_attrs 180 170 1100 (-161) 0 0 0>
             ,<&key_physical_attrs 180 170 0 (-338) 0 0 0>
             ,<&key_physical_attrs 180 170 100 (-338) 0 0 0>
             ,<&key_physical_attrs 180 170 200 (-330) 0 0 0>
             ,<&key_physical_attrs 180 170 300 (-325) 0 0 0>
             ,<&key_physical_attrs 180 170 400 (-330) 0 0 0>
             ,<&key_physical_attrs 180 170 500 (-330) 0 0 0>
             ,<&key_physical_attrs 180 170 600 (-330) 0 0 0>
             ,<&key_physical_attrs 180 170 700 (-330) 0 0 0>
             ,<&key_physical_attrs 180 170 800 (-330) 0 0 0>
             ,<&key_physical_attrs 180 170 900 (-330) 0 0 0>
             ,<&key_physical_attrs 180 170 1000 (-330) 0 0 0>
             ,<&key_physical_attrs 180 170 1100 (-330) 0 0 0>
    };
};