## boards/shields/Kconfig.defconfig
```kconfig
if TeeDa_LEFT

# Name must be less than 16 characters long!
config ZMK_KEYBOARD_NAME
    default "My Keyboard"

config ZMK_SPLIT_ROLE_CENTRAL
    default y

endif

if TeeDa_LEFT || TeeDa_RIGHT

config ZMK_SPLIT
    default y

endif
```

## boards/shields/Kconfig.shield
```kconfig
config SHIELD_TEEDA_LEFT
    def_bool $(shields_list_contains,TeeDa_left)

config SHIELD_TEEDA_RIGHT
    def_bool $(shields_list_contains,TeeDa_right)
```

## boards/shields/TeeDa/Kconfig.shield
```kconfig
config SHIELD_TEEDA_LEFT
    def_bool $(shields_list_contains,TeeDa-left)

config SHIELD_TEEDA_RIGHT
    def_bool $(shields_list_contains,TeeDa-right)
```

## config/boards/shields/TeeDa/Kconfig.shield
```kconfig
# No whitespace after the comma or in your part name!
config SHIELD_TEEDA_LEFT
    def_bool $(shields_list_contains,TeeDa_left)

# No whitespace after the comma or in your part name!
config SHIELD_TEEDA_RIGHT
    def_bool $(shields_list_contains,TeeDa_right)
```
